## arch/x86/kvm/sample/Kconfig
```kconfig
config KVM_EPT_SAMPLE_DRIVER
    tristate "KVM EPT Sample Driver"
    depends on KVM_EPT_SAMPLE
    help
      This is a sample KVM EPT driver for x86 platforms.
```

## mm/vtism/Kconfig
```kconfig
menuconfig VTISM
    tristate "Enable VTISM"
    depends on MIGRATION && HOTPLUG_CPU && NUMA

if VTISM

config VTISM_MODULE_SYM_EXPORT
    bool "Allow modular compilation of VTISM"
    default y
    depends on VTISM=y
    help
        Allow the VTISM module to be compiled as a loadable kernel module. 
        This option is automatically enabled when VTISM is set to 'm'.

config VTISM_DEBUG
    bool "Enable VTISM debug"
    default n
    depends on VTISM=y
    help
        Enable VTISM debug.

config VTISM_DEMOTION_MIN_FREE_RATIO
    int "Minimum free memory ratio for page demotion"
    default 5
    range 1 100
    help
        Specify the minimum free memory ratio for page demotion. which can
        also change by /sys/kernel/mm/vtism/demotion_min_free_ratio

endif # VTISM
```
